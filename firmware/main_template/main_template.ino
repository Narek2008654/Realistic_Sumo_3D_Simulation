// main_template.ino — Mini Sumo Arduino Nano main-loop template.
//
// Pipeline (24 Hz target loop, matching STEP_DT_SECONDS in sumo_env.py):
//
//   read sensors → update last-seen latch → predict_motors → drive motors
//                                          ↑
//   watchdog: if no forward sensor < 80 % of max range for > 1500 ms,
//   override predict_motors with a hand-coded search-spin (+0.6, -0.6)
//   until the first valid read re-engages NN control.
//
// Drop the trained header (neural_net_v4.h, generated by
// export_weights.py) and arduino_obs_logic.h next to this sketch.
//
// User-replaceable hardware bindings live at the bottom; replace the
// stubs with calls to your VL53L1X / QTR / motor-driver libraries.

#include <string.h>              // memcmp — for I2C staleness bit-comparison

#include "neural_net_v4.h"       // SAC actor weights + LUT + verify_self_test
#include "arduino_obs_logic.h"   // mirror of sumo_env's _update_last_seen

// =====================================================================
// User-replaceable hardware bindings — see stubs at the bottom.
// =====================================================================

extern float read_tof_front_m();   // metres; NaN or >= ENEMY_FAR_DIST = no-hit
extern float read_tof_left_m();
extern float read_tof_right_m();
extern bool  read_line_l();        // rear-left QTR over white border ring
extern bool  read_line_r();
extern void  drive_left_motor(float cmd);   // cmd ∈ [-1, +1]
extern void  drive_right_motor(float cmd);

// =====================================================================
// Watchdog — search-spin fallback if the agent loses the target.
// =====================================================================

// Match sumo_env.py: ENEMY_FAR_DIST = 0.80 m.
constexpr float    VALID_RANGE_M       = 0.80f * mini_sumo_obs::ENEMY_FAR_DIST;
constexpr uint16_t WATCHDOG_TIMEOUT_MS = 1500;
constexpr float    SEARCH_LEFT         = +0.6f;  // tank-spin: left forward
constexpr float    SEARCH_RIGHT        = -0.6f;  //            right reverse

// I2C staleness detector: VL53L1X returns the LAST cached reading
// when the bus hangs (NaN would be safer but the chip won't volunteer
// it). If all three forward sensors return byte-identical values for
// STALE_THRESHOLD consecutive loops, treat the bus as faulted and
// enter search-spin until the readings start changing again.
constexpr uint8_t  STALE_THRESHOLD     = 10;

mini_sumo_obs::LastSeenState last_seen_state;
mini_sumo_obs::PrevActionState prev_action;
mini_sumo_obs::EngagementTimerState engagement_timer;
mini_sumo_obs::YawRateProxyState yaw_rate_proxy;
mini_sumo_obs::IrDeltaState ir_delta_state;
uint32_t last_valid_sensor_ms = 0;
float    prev_front_m = NAN, prev_left_m = NAN, prev_right_m = NAN;
uint8_t  stale_count  = 0;

static inline bool any_forward_valid(float front_m, float left_m, float right_m) {
    // A "valid hit" is any forward sensor reading inside 80 % max range.
    // NaN comparisons evaluate to false, so dropouts don't reset the timer.
    return (front_m < VALID_RANGE_M)
        || (left_m  < VALID_RANGE_M)
        || (right_m < VALID_RANGE_M);
}

// Bit-exact comparison: NaN != anything (including NaN), so an all-NaN
// bus produces fresh reads each loop and never trips the staleness
// counter — which is what we want, since we care about "frozen cached
// non-NaN" not "consistent dropout".
static inline bool readings_identical(float a, float b) {
    return memcmp(&a, &b, sizeof(float)) == 0;
}

static bool detect_stale_bus(float front_m, float left_m, float right_m) {
    const bool same =
        readings_identical(front_m, prev_front_m) &&
        readings_identical(left_m,  prev_left_m)  &&
        readings_identical(right_m, prev_right_m);
    prev_front_m = front_m;
    prev_left_m  = left_m;
    prev_right_m = right_m;
    if (same) {
        if (stale_count < 255) stale_count++;
    } else {
        stale_count = 0;
    }
    return stale_count >= STALE_THRESHOLD;
}

static inline float norm_distance(float d) {
    // Mirror sumo_env._norm: clamp(d / ENEMY_FAR_DIST, 0, 1).
    // NaN / no-hit → 1.0 (the maximum-range encoding the agent saw in sim).
    if (isnan(d) || d >= mini_sumo_obs::ENEMY_FAR_DIST) return 1.0f;
    if (d <= 0.0f) return 0.0f;
    return d / mini_sumo_obs::ENEMY_FAR_DIST;
}

// =====================================================================

void setup() {
    Serial.begin(115200);
    while (!Serial && millis() < 3000) {}

    Serial.println(F("=== mini_sumo main_template ==="));

    // Refuse to drive anything if the model self-test fails — the
    // weights or LUT may have corrupted in flash.
    const float selftest_delta = mini_sumo_ai::verify_self_test();
    Serial.print(F("selftest max delta: "));
    Serial.println(selftest_delta, 6);
    if (selftest_delta > 1.0e-3f) {
        Serial.println(
            F("FATAL: selftest > 1e-3, halting (re-flash the header)")
        );
        while (1) {
            drive_left_motor(0.0f);
            drive_right_motor(0.0f);
            delay(100);
        }
    }

    mini_sumo_obs::reset(last_seen_state);
    mini_sumo_obs::reset(prev_action);
    mini_sumo_obs::reset(engagement_timer);
    mini_sumo_obs::reset(yaw_rate_proxy);
    mini_sumo_obs::reset(ir_delta_state);
    last_valid_sensor_ms = millis();

    // TODO(user): init Wire, sensors, motor drivers here.
    Serial.println(F("ready"));
}

void loop() {
    // 1. Read sensors. Replace stubs with real driver calls.
    const float front_m = read_tof_front_m();
    const float left_m  = read_tof_left_m();
    const float right_m = read_tof_right_m();
    const bool  ll      = read_line_l();
    const bool  lr      = read_line_r();

    const uint32_t now = millis();

    // 2. Watchdog timer: any "valid hit" resets the countdown.
    if (any_forward_valid(front_m, left_m, right_m)) {
        last_valid_sensor_ms = now;
    }

    // 3. Latch the last-seen direction (Python parity via arduino_obs_logic.h).
    mini_sumo_obs::update_last_seen(
        last_seen_state, front_m, left_m, right_m
    );

    float out_l = 0.0f, out_r = 0.0f;

    // 4. Search-spin override fires for either fault mode:
    //    (a) WATCHDOG_TIMEOUT_MS without a valid hit  (lost target), or
    //    (b) I2C bus serving identical readings for STALE_THRESHOLD
    //        consecutive loops (sensor frozen / bus hang).
    const bool stale_bus = detect_stale_bus(front_m, left_m, right_m);
    const bool watchdog_fired = (now - last_valid_sensor_ms) > WATCHDOG_TIMEOUT_MS;
    if (watchdog_fired || stale_bus) {
        out_l = SEARCH_LEFT;
        out_r = SEARCH_RIGHT;
    } else {
        // 5. NN inference: 12D obs → 2D motor commands.
        const float fn = norm_distance(front_m);
        const float ln = norm_distance(left_m);
        const float rn = norm_distance(right_m);
        // Engagement timer increments BEFORE inference so the value
        // the policy sees reflects this tick's sensor state — matches
        // sumo_env.py ordering.
        mini_sumo_obs::update(engagement_timer, fn);
        // Run 9: compute IR temporal deltas BEFORE inference so they
        // reflect (this_tick - last_tick). The update call also caches
        // this frame's normalised values for next loop.
        float front_delta = 0.0f, lateral_delta = 0.0f;
        mini_sumo_obs::update(
            ir_delta_state, fn, ln, rn, front_delta, lateral_delta
        );
        mini_sumo_ai::predict_motors(
            fn, ln, rn, last_seen_state.dir,
            ll ? 1.0f : 0.0f, lr ? 1.0f : 0.0f,
            prev_action.left, prev_action.right,
            mini_sumo_obs::normalized(engagement_timer),
            yaw_rate_proxy.value,
            front_delta, lateral_delta,
            out_l, out_r
        );
        // Update accumulators with the action just commanded:
        // - prev_action latch (obs[6:8] next tick)
        // - yaw-rate proxy   (obs[9]   next tick)
        // Watchdog/staleness branches above SKIP these updates so the
        // policy sees the last "real" intent on re-engagement.
        // IR delta cache is updated inside the update() call above, so
        // we don't duplicate it here; the watchdog branch correctly
        // leaves the delta state at the previous frame's values, which
        // produces a zero delta on the next valid sensor read (correct
        // behaviour — no spurious motion signal coming out of search).
        mini_sumo_obs::update(prev_action, out_l, out_r);
        mini_sumo_obs::update(yaw_rate_proxy, out_l, out_r);
    }

    // 6. Drive motors. Both commands are already in [-1, +1].
    drive_left_motor(out_l);
    drive_right_motor(out_r);

    // No explicit delay — the loop runs as fast as the sensors + inference
    // allow. Use the benchmark sketch (firmware/benchmark/) to measure
    // real latency and confirm we beat STEP_DT_SECONDS = 41.67 ms.
}

// =====================================================================
// SAFE STUBS — replace each with your real hardware driver call.
// As written they let the sketch link cleanly so you can flash and
// confirm the watchdog spins the bot before wiring real sensors.
// =====================================================================

float read_tof_front_m() {
    // TODO(user): return the VL53L1X distance in metres, or NAN on dropout.
    return NAN;
}

float read_tof_left_m() {
    // TODO(user): same shape as read_tof_front_m().
    return NAN;
}

float read_tof_right_m() {
    // TODO(user): same shape as read_tof_front_m().
    return NAN;
}

bool read_line_l() {
    // TODO(user): return true when the rear-left QTR is over the white border.
    return false;
}

bool read_line_r() {
    // TODO(user): return true when the rear-right QTR is over the white border.
    return false;
}

void drive_left_motor(float /*cmd*/) {
    // TODO(user): map cmd ∈ [-1, +1] to your motor driver (e.g. PWM 0–255
    // with a direction pin, or signed PWM on a TB6612FNG / DRV8833).
}

void drive_right_motor(float /*cmd*/) {
    // TODO(user): same shape as drive_left_motor.
}
