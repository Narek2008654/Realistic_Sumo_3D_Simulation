// benchmark.ino — measure mini_sumo_ai::predict_action() latency.
//
// Drop the trained header (neural_net_v6_3d.h, generated by
// export_weights.py) next to this sketch. Flash, open Serial Monitor
// at 115200 baud, and wait a few seconds for output.
//
// Output:
//   self-test mismatches: <int>     (parity with Python; 0 = healthy)
//   forward pass: n=1000  mean=<us>  max=<us>  total=<us>
//   last action: idx + (out_l, out_r)   (printed so the compiler can't
//                                   optimise the predict loop away)
//
// Use the mean to validate STEP_DT_SECONDS in sumo_env.py:
//   STEP_DT_SECONDS = SUBSTEPS_PER_STEP * SIM_TIMESTEP  (Python = 41.67 ms)
// Real Arduino loop dt = sensor read + predict_action + motor update.
// Aim for predict_action << STEP_DT_SECONDS so the rest of the loop
// fits in budget.

#include "neural_net_v6_3d.h"

constexpr uint16_t N_ITERATIONS = 1000;

// Dummy observation — non-zero across the obs vector so every layer
// of the network sees real activations. Values come from the env's
// normalised range:
//   front/left/right ∈ [0, 1], last_seen ∈ {-1, 0, +1}, line_* ∈ {0, 1},
//   prev_left/right ∈ [-1, +1], engagement ∈ [0, 1], yaw_rate ∈ [-1, +1],
//   front/lateral IR deltas ∈ [-1, +1].
const float DUMMY_OBS[mini_sumo_ai::INPUT_DIM] = {
    0.50f,  // front
    0.30f,  // left
    0.70f,  // right
   +1.0f,   // last_seen (right)
    0.0f,   // line_l
    1.0f,   // line_r (rear-right edge sensor lit)
   +0.4f,   // prev_left
   -0.2f,   // prev_right
    0.6f,   // engagement (~18 ticks of close-front lock)
   +0.3f,   // yaw_rate_proxy (mild rightward turn)
   -0.2f,   // front_ir_delta (target closing)
   +0.1f    // lateral_ir_delta (drifting right)
};

void setup() {
    Serial.begin(115200);
    // Wait for USB-CDC up to 3 s so the host has time to attach.
    while (!Serial && millis() < 3000) {}

    Serial.println(F("=== mini_sumo_ai inference benchmark ==="));
    Serial.print(F("INPUT_DIM=")); Serial.print(mini_sumo_ai::INPUT_DIM);
    Serial.print(F("  H1=")); Serial.print(mini_sumo_ai::H1_DIM);
    Serial.print(F("  H2=")); Serial.print(mini_sumo_ai::H2_DIM);
    Serial.print(F("  N_ACTIONS=")); Serial.println(mini_sumo_ai::N_ACTIONS);

    // ---- 1. Self-test parity check ---------------------------------
    const uint8_t mismatches = mini_sumo_ai::verify_self_test();
    Serial.print(F("self-test mismatches: "));
    Serial.println(mismatches);
    if (mismatches > 0) {
        Serial.println(
            F("  WARNING: weight corruption suspected (mismatches > 0)")
        );
    }

    // ---- 2. Latency benchmark --------------------------------------
    volatile uint16_t idx_sum = 0;  // anti-elision accumulator
    uint32_t total_us = 0;
    uint32_t max_us = 0;

    for (uint16_t k = 0; k < N_ITERATIONS; ++k) {
        const uint32_t t0 = micros();
        const uint8_t a_idx = mini_sumo_ai::predict_action(DUMMY_OBS);
        const uint32_t dt = micros() - t0;
        idx_sum += a_idx;
        total_us += dt;
        if (dt > max_us) max_us = dt;
    }

    const float mean_us = (float)total_us / (float)N_ITERATIONS;
    Serial.print(F("forward pass: n="));
    Serial.print(N_ITERATIONS);
    Serial.print(F("  mean=")); Serial.print(mean_us, 2);
    Serial.print(F(" us  max=")); Serial.print(max_us);
    Serial.print(F(" us  total=")); Serial.print(total_us);
    Serial.println(F(" us"));

    // ---- 3. Anti-elision printout ----------------------------------
    // Force the compiler to keep predict_action live by deriving a
    // final action from DUMMY_OBS after the loop and reading the
    // accumulated idx_sum. Without this, -O2 may optimise the entire
    // benchmark away.
    const uint8_t a_idx = mini_sumo_ai::predict_action(DUMMY_OBS);
    float out_l = 0.0f, out_r = 0.0f;
    mini_sumo_ai::action_to_motors(a_idx, out_l, out_r);
    Serial.print(F("idx_sum: ")); Serial.println(idx_sum);
    Serial.print(F("last action: idx="));
    Serial.print(a_idx); Serial.print(F(" ("));
    Serial.print(out_l, 4); Serial.print(F(", "));
    Serial.print(out_r, 4); Serial.println(F(")"));

    Serial.println(F("=== done ==="));
}

void loop() {
    // No-op. Reset / re-flash to re-run.
}
